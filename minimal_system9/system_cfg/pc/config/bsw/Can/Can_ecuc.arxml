AUTOSAR XML (schema 00046)
package /ActiveEcuC
  module config Can: implementation-config-variant=VARIANT-PRE-COMPILE
    CanGeneral:
      CanDevErrorDetection = (unset)
      CanIndex = 0
      CanMainFunctionModePeriod = 0.01
      CanMultiplexedTransmission = (unset)
      CanTimeoutDuration = 0.001
      CanVersionInfoApi = (unset)
      CanSupportTTCANRef = CanIfPrivateCfg
      CanPcRpc: CanRpcHost=127.0.0.1, CanRpcPort=17320, CanRpcSocketPath=, CanRpcAutoReconnect=true, CanRpcReconnectIntervalMs=500
    CanConfigSet
      CanController_0 (CanController):
        CanBusoffProcessing = POLLING
        CanRpcVendor = simulate
        CanRxProcessing = POLLING
        CanTxProcessing = POLLING
        CanWakeupProcessing = POLLING
        CanControllerActivation = true
        CanControllerId = 0
        CanRpcCanFd = false
        CanRpcHandle = 1
        CanWakeupFunctionalityAPI = false
        CanWakeupSupport = (unset)
        CanControllerDefaultBaudrate = CanControllerBaudrateConfig_0
        CanControllerBaudrateConfig_0 (CanControllerBaudrateConfig):
          CanControllerBaudRate = 500
          CanControllerBaudRateConfigID = 0
          CanControllerPropSeg = 1
          CanControllerSeg1 = 12
          CanControllerSeg2 = 2
          CanControllerSyncJumpWidth = 1
      3 x CanHardwareObject, all with CanIdType=STANDARD, CanHwObjectCount=1, CanControllerRef=CanController_0:
        CanHardwareObject_0: CanHandleType=FULL, CanObjectType=TRANSMIT, CanObjectId=0
        CanHardwareObject_1: CanHandleType=BASIC, CanObjectType=RECEIVE, CanObjectId=1
        CanHardwareObject_2: CanHandleType=FULL, CanObjectType=TRANSMIT, CanObjectId=2
