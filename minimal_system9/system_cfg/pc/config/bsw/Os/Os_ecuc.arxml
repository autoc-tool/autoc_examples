AUTOSAR XML (schema 00046)
package /ActiveEcuC
  module config Os: implementation-config-variant=VARIANT-PRE-COMPILE, module-description=Os_Impl
    OSDEFAULTAPPMODE (OsAppMode)
    OSAUTOSTARTMODE (OsAppMode)
    4 x OsApplication, all with OsIsPrivileged=true, OsAppMemoryProtectionIdentifier=(unset), OsAppIsrRef=(unset):
      SystemApplication_Core0: OsAppCounterRef=OsCounter_0, OsAppEcucPartitionRef=/ActiveEcuC/EcuC/EcucPartitionCollection/EcucPartition_0, OsApplicationCoreRef=/ActiveEcuC/EcuC/EcucHardware/EcucCoreDefinition0, OsAppScheduleTableRef=SchTbl_5ms, OsAppTaskRef=core0_shell, OsAppTaskRef=OsTask_Init, OsAppTaskRef=OsTask_5ms, OsAppTaskRef=OsTask_10ms, OsAppScheduleTableRef=SchTbl_10ms
      SystemApplication_Core{1..3}: OsAppCounterRef=(unset), OsAppEcucPartitionRef=/ActiveEcuC/EcuC/EcucPartitionCollection/EcucPartition_{1..3}, OsApplicationCoreRef=/ActiveEcuC/EcuC/EcucHardware/EcucCoreDefinition{1..3}, OsAppScheduleTableRef=(unset), OsAppTaskRef=/ActiveEcuC/Os/core{1..3}_shell
    4 x OsTask, all with OsTaskUsesFpu=true, OsTaskActivation=1, OsTaskStackSize=4096, OsTaskType=EXTENDED, OsTaskSchedule=FULL, OsTaskEventRef=(unset), OsTaskResourceRef=(unset):
      core0_shell: OsTaskPriority=10, OsTaskAccessingApplication=/ActiveEcuC/Os/SystemApplication_Core0
        OsTaskAutostart: OsTaskAppModeRef=/ActiveEcuC/Os/OSAUTOSTARTMODE
      core1_shell: OsTaskPriority=10, OsTaskAccessingApplication=/ActiveEcuC/Os/SystemApplication_Core1
        OsTaskAutostart: OsTaskAppModeRef=/ActiveEcuC/Os/OSAUTOSTARTMODE
      core2_shell: OsTaskPriority=5, OsTaskAccessingApplication=/ActiveEcuC/Os/SystemApplication_Core2
        OsTaskAutostart: OsTaskAppModeRef=/ActiveEcuC/Os/OSAUTOSTARTMODE
      core3_shell: OsTaskPriority=5, OsTaskAccessingApplication=/ActiveEcuC/Os/SystemApplication_Core3
        OsTaskAutostart: OsTaskAppModeRef=/ActiveEcuC/Os/OSAUTOSTARTMODE
    4 x OsCore:
      OsCore{0..3}: OsCoreBswApplicationRef=/ActiveEcuC/Os/SystemApplication_Core{0..3}, OsCoreEcucIdRef=EcucCoreDefinition{0..3}
    OsPublishedInformation: OsKernelVersion=V5.2.0, OsPlatformName=PC_Common
      OsDerivativeInformation
        4 x OsPhysicalCore:
          OsPhysicalCore_{0..3}: OsPhysicalCoreId={0..3}
    3 x OsTask, all with OsTaskActivation=1, OsTaskStackSize=4096, OsTaskUsesFpu=true, OsTaskSchedule=FULL, OsTaskType=BASIC, OsTaskAccessingApplication=SystemApplication_Core0:
      OsTask_Init: OsTaskPriority=10
        OsTaskAutostart: OsTaskAppModeRef=OSAUTOSTARTMODE
      OsTask_5ms: OsTaskPriority=7
      OsTask_10ms: OsTaskPriority=5
    OsCounter_0 (OsCounter):
      OsCounterMaxAllowedValue = 2147483647
      OsCounterMinCycle = 1
      OsCounterTicksPerBase = 1
      OsSecondsPerTick = 0.001
      OsCounterType = SOFTWARE
      OsCounterAccessingApplication = SystemApplication_Core0
    SchTbl_5ms (OsScheduleTable):
      OsScheduleTableDuration = 5
      OsScheduleTableRepeating = true
      OsScheduleTableCounterRef = OsCounter_0
      OsSchTblAccessingApplication = SystemApplication_Core0
      Exp (OsScheduleTableExpiryPoint): OsScheduleTblExpPointOffset=0
        Act (OsScheduleTableTaskActivation): OsScheduleTableActivateTaskRef=OsTask_5ms
      OsScheduleTableAutostart: OsScheduleTableAutostartType=ABSOLUTE, OsScheduleTableStartValue=0, OsScheduleTableAppModeRef=OSAUTOSTARTMODE
    SchTbl_10ms (OsScheduleTable):
      OsScheduleTableDuration = 10
      OsScheduleTableRepeating = true
      OsScheduleTableCounterRef = OsCounter_0
      OsSchTblAccessingApplication = SystemApplication_Core0
      Exp (OsScheduleTableExpiryPoint): OsScheduleTblExpPointOffset=0
        Act (OsScheduleTableTaskActivation): OsScheduleTableActivateTaskRef=OsTask_10ms
      OsScheduleTableAutostart: OsScheduleTableAutostartType=ABSOLUTE, OsScheduleTableStartValue=0, OsScheduleTableAppModeRef=OSAUTOSTARTMODE
    Rte_Ev_Cyclic2_OsTask_5ms_0_5ms (OsEvent): OsEventMask=1
    Rte_Ev_Cyclic_OsTask_10ms_0_10ms (OsEvent): OsEventMask=1
