AUTOSAR XML (schema 00046)
package /ActiveEcuC
  module config PduR: implementation-config-variant=VARIANT-PRE-COMPILE, module-description=PduR_Impl
    PduRGeneral: PduRDevErrorDetect=false, PduRMetaDataSupport=false, PduRSpinlockRetryCounter=3, PduRVersionInfoApi=false, PduRZeroCostOperation=false
    PduRRoutingPaths: PduRConfigurationId=0, PduRMaxRoutingPathCnt=65535, PduRMaxRoutingPathGroupCnt=65535
      3 x PduRDestPdu, all with PduRTransmissionConfirmation=(unset), PduRDestPduDataProvision=PDUR_DIRECT:
        Cmd_Control_Rx_Dest: PduRDestPduHandleId=0, PduRDestPduRef=Cmd_Control
        ECU_Status_Tx_Dest: PduRDestPduHandleId=1, PduRDestPduRef=ECU_Status
        Fault_Event_Tx_Dest: PduRDestPduHandleId=2, PduRDestPduRef=Fault_Event
      3 x PduRRoutingPath:
        Cmd_Control_Rx: PduRSrcPduRRef=Cmd_Control_Rx_Src, PduRDestPduRRef=Cmd_Control_Rx_Dest
        ECU_Status_Tx: PduRSrcPduRRef=ECU_Status_Tx_Src, PduRDestPduRRef=ECU_Status_Tx_Dest
        Fault_Event_Tx: PduRSrcPduRRef=Fault_Event_Tx_Src, PduRDestPduRRef=Fault_Event_Tx_Dest
      3 x PduRSrcPdu, all with PduRSrcPduUpTxConf=true:
        Cmd_Control_Rx_Src: PduRSourcePduHandleId=0, PduRSrcPduRef=Cmd_Control
        ECU_Status_Tx_Src: PduRSourcePduHandleId=1, PduRSrcPduRef=ECU_Status
        Fault_Event_Tx_Src: PduRSourcePduHandleId=2, PduRSrcPduRef=Fault_Event
    CanIf (PduRBswModules):
      PduRCancelReceive = (unset)
      PduRCancelTransmit = (unset)
      PduRCommunicationInterface = true
      PduRLowerModule = true
      PduRRetransmission = (unset)
      PduRTransportProtocol = (unset)
      PduRTriggertransmit = (unset)
      PduRTxConfirmation = (unset)
      PduRUpperModule = (unset)
      PduRUseTag = (unset)
      PduRBswModuleRef = CanIf
    Com (PduRBswModules):
      PduRCancelReceive = (unset)
      PduRCancelTransmit = (unset)
      PduRCommunicationInterface = true
      PduRLowerModule = (unset)
      PduRRetransmission = (unset)
      PduRTransportProtocol = (unset)
      PduRTriggertransmit = (unset)
      PduRTxConfirmation = (unset)
      PduRUpperModule = true
      PduRUseTag = (unset)
      PduRBswModuleRef = Com
