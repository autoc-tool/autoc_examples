AUTOSAR XML (schema 00046)
package /ActiveEcuC
  module config ComM: implementation-config-variant=VARIANT-PRE-COMPILE, module-description=ComM_Impl
    ComMGeneral:
      ComM0PncVectorAvoidance = false
      ComMDevErrorDetect = false
      ComMDirectUserMapping = false
      ComMModeLimitationEnabled = false
      ComMPncGatewayEnabled = false
      ComMPncSupport = false
      ComMResetAfterForcingNoComm = false
      ComMSynchronousWakeUp = true
      ComMVersionInfoApi = false
      ComMWakeupInhibitionEnabled = false
      ComMPncPrepareSleepTimer = 0
      ComMTMinFullComModeDuration = 5
      ComMEcuGroupClassification = 3
      ComMGlobalNvMBlockDescriptor = <empty>
    ComMConfigSet: ComMPncEnabled=false
      ComMUser_0 (ComMUser): ComMUserIdentifier=0
      CAN1 (ComMChannel):
        ComMChannelId = 0
        ComMFullCommRequestNotificationEnabled = false
        ComMMainFunctionPeriod = 0.005
        ComMNoCom = false
        ComMNoWakeup = false
        ComMNoWakeUpInhibitionNvmStorage = (unset)
        ComMBusType = COMM_BUS_TYPE_CAN
        ComMNetworkManagement: ComMNmVariant=FULL, ComMPncNmRequest=false
        ComMUserPerChannel_0 (ComMUserPerChannel): ComMUserChannel=ComMUser_0
