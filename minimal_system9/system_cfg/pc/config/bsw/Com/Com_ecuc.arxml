AUTOSAR XML (schema 00046)
package /ActiveEcuC
  module config Com: implementation-config-variant=VARIANT-PRE-COMPILE, module-description=Com_Impl
    ComConfig: ComDataMemSize=0, ComMaxIPduCnt=0
      Com_MainFunction_Rx (ComMainFunctionRx): MainRxTimeBase=0.005
      Com_MainFunction_Tx (ComMainFunctionTx): MainTxTimeBase=0.005
      Com_MainFunction_Gw (ComMainFunctionGw): MainGwTimeBase=0.005
      3 x ComIPdu, all with ComIPduSignalProcessing=DEFERRED, ComIPduType=NORMAL:
        Cmd_Control: ComIPduDirection=RECEIVE, ComIPduHandleId=0, ComIPduGroupRef=ComRxGroup, ComIPduSignalRef=LedCmd_o_Cmd_Control_Rx, ComIPduSignalRef=TargetMode_o_Cmd_Control_Rx, ComIPduSignalRef=Cmd_AliveCnt_o_Cmd_Control_Rx, ComIPduSignalRef=PwmDuty_o_Cmd_Control_Rx, ComIPduSignalRef=Cmd_Crc8_o_Cmd_Control_Rx, ComPduIdRef=Cmd_Control, IPduMainFunctionRef=Com_MainFunction_Rx
        ECU_Status: ComIPduDirection=SEND, ComIPduHandleId=1, ComIPduGroupRef=ComTxGroup, ComIPduSignalRef=ECU_State_o_ECU_Status_Tx, ComIPduSignalRef=ECU_AliveCnt_o_ECU_Status_Tx, ComIPduSignalRef=Temperature_o_ECU_Status_Tx, ComIPduSignalRef=SupplyVoltage_o_ECU_Status_Tx, ComIPduSignalRef=FaultFlags_o_ECU_Status_Tx, ComPduIdRef=ECU_Status, IPduMainFunctionRef=Com_MainFunction_Tx
          ComTxIPdu: ComTxIPduUnusedAreasDefault=0, ComTxIPduClearUpdateBit=Confirmation
            ComTxModeTrue
              ComTxMode: ComTxModeMode=PERIODIC, ComTxModeTimePeriod=0.1
            ComTxModeFalse
              ComTxMode: ComTxModeMode=PERIODIC, ComTxModeTimePeriod=0.1
        Fault_Event: ComIPduDirection=SEND, ComIPduHandleId=2, ComIPduGroupRef=ComTxGroup, ComIPduSignalRef=FaultCode_o_Fault_Event_Tx, ComIPduSignalRef=FaultActive_o_Fault_Event_Tx, ComPduIdRef=Fault_Event, IPduMainFunctionRef=Com_MainFunction_Tx
          ComTxIPdu: ComTxIPduUnusedAreasDefault=0, ComTxIPduClearUpdateBit=Confirmation
            ComTxModeTrue
              ComTxMode: ComTxModeMode=DIRECT
            ComTxModeFalse
              ComTxMode: ComTxModeMode=NONE
      12 x ComSignal, all with ComSignalEndianness=LITTLE_ENDIAN:
        LedCmd_o_Cmd_Control_Rx: ComBitPosition=0, ComBitSize=1, ComSignalType=BOOLEAN, ComTransferProperty=PENDING, ComSystemTemplateSystemSignalRef=LedCmd
        TargetMode_o_Cmd_Control_Rx: ComBitPosition=1, ComBitSize=3, ComSignalType=UINT8, ComTransferProperty=PENDING, ComSystemTemplateSystemSignalRef=TargetMode
        Cmd_AliveCnt_o_Cmd_Control_Rx: ComBitPosition=4, ComBitSize=4, ComSignalType=UINT8, ComTransferProperty=PENDING, ComSystemTemplateSystemSignalRef=Cmd_AliveCnt
        PwmDuty_o_Cmd_Control_Rx: ComBitPosition=8, ComBitSize=8, ComSignalType=UINT8, ComTransferProperty=PENDING, ComSystemTemplateSystemSignalRef=PwmDuty
        Cmd_Crc8_o_Cmd_Control_Rx: ComBitPosition=56, ComBitSize=8, ComSignalType=UINT8, ComTransferProperty=PENDING, ComSystemTemplateSystemSignalRef=Cmd_Crc8
        ECU_State_o_ECU_Status_Tx: ComBitPosition=0, ComBitSize=4, ComSignalType=UINT8, ComTransferProperty=PENDING, ComSystemTemplateSystemSignalRef=ECU_State
        ECU_AliveCnt_o_ECU_Status_Tx: ComBitPosition=4, ComBitSize=4, ComSignalType=UINT8, ComTransferProperty=PENDING, ComSystemTemplateSystemSignalRef=ECU_AliveCnt
        Temperature_o_ECU_Status_Tx: ComBitPosition=8, ComBitSize=8, ComSignalType=UINT8, ComTransferProperty=PENDING, ComSystemTemplateSystemSignalRef=Temperature
        SupplyVoltage_o_ECU_Status_Tx: ComBitPosition=16, ComBitSize=16, ComSignalType=UINT16, ComTransferProperty=PENDING, ComSystemTemplateSystemSignalRef=SupplyVoltage
        FaultFlags_o_ECU_Status_Tx: ComBitPosition=32, ComBitSize=8, ComSignalType=UINT8, ComTransferProperty=PENDING, ComSystemTemplateSystemSignalRef=FaultFlags
        FaultCode_o_Fault_Event_Tx: ComBitPosition=0, ComBitSize=8, ComSignalType=UINT8, ComTransferProperty=TRIGGERED_ON_CHANGE_WITHOUT_REPETITION, ComSystemTemplateSystemSignalRef=FaultCode
        FaultActive_o_Fault_Event_Tx: ComBitPosition=8, ComBitSize=1, ComSignalType=BOOLEAN, ComTransferProperty=PENDING, ComSystemTemplateSystemSignalRef=FaultActive
      ComTxGroup (ComIPduGroup): ComIPduGroupHandleId=1
      ComRxGroup (ComIPduGroup): ComIPduGroupHandleId=2
    ComGeneral:
      ComCancellationSupport = true
      ComConfigurationUseDet = false
      ComEnableMDTForCyclicTransmission = true
      ComEnableSignalGroupArrayApi = false
      ComMetaDataSupport = false
      ComRetryFailedTransmitRequests = false
      ComVersionInfoApi = false
      ComSupportedIPduGroups = 0
      ComUserCbkHeaderFile = (unset)
