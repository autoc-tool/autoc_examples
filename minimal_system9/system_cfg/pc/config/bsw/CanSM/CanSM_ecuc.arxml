AUTOSAR XML (schema 00046)
package /ActiveEcuC
  module config CanSM: implementation-config-variant=VARIANT-PRE-COMPILE, module-description=CanSM_Impl
    CanSMGeneral:
      CanSMDevErrorDetect = false
      CanSMIcomSupport = false
      CanSMPncSupport = false
      CanSMSetBaudrateApi = false
      CanSMTxOfflineActiveSupport = false
      CanSMVersionInfoApi = false
      CanSMGetBusOffDelayFunction = (unset)
      BusOffBeginFunction = (unset)
      BusOffEndFunction = (unset)
      CanSMGetBusOffDelayHeader = (unset)
    CanSMConfiguration: CanSMModeRequestRepetitionTime=0.1, CanSMModeRequestRepetitionMax=10
      CanSM_MainFunction (CanSMMainFunction): CanSMMainFunctionPeriod=0.005
      CanSMManagerNetwork_0 (CanSMManagerNetwork):
        CanSMBorCounterL1ToL2 = 5
        CanSMBorTimeL1 = 0.1
        CanSMBorTimeL2 = 1.0
        CanSMBorTimeTxEnsured = 2.0
        CanSMBorTxConfirmationPolling = (unset)
        CanSMComMNetworkHandleRef = CAN1
        CanSMTransceiverId = CanIfTrcvCfg
        CanSMManagerNetwork_0 (CanSMController): CanSMControllerId=CanController_0
