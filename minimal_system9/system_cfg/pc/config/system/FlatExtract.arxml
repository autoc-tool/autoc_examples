AUTOSAR XML (schema 4-2-1)
package /COM/VCOS2/CFG/WORKFLOW/SYSDESC/SYNC
  composition sw component type COMPOSITIONTYPE  # UB:Derived from original system description
    component MinimalSystem: type=MinimalSystem
    component IoHwAb: type=IoHwAb
    connect MinimalSystem.IoOut_P -> IoHwAb.IoIn_R
  end to end protection set E2EPROTECTIONSET
  port interface mapping set PORTINTERFACEMAPPINGSET
  system SYSTEM: category=ECU_EXTRACT
    system mapping MAPPINGS
      data-mappings:
        data-element=MinimalSystem.COMPOSITIONTYPE.EcuStatus_P.ECU_State, system-signal=ECU_State
        data-element=MinimalSystem.COMPOSITIONTYPE.EcuStatus_P.ECU_AliveCnt, system-signal=ECU_AliveCnt
        data-element=MinimalSystem.COMPOSITIONTYPE.EcuStatus_P.Temperature, system-signal=Temperature
        data-element=MinimalSystem.COMPOSITIONTYPE.EcuStatus_P.SupplyVoltage, system-signal=SupplyVoltage
        data-element=MinimalSystem.COMPOSITIONTYPE.EcuStatus_P.FaultFlags, system-signal=FaultFlags
        data-element=MinimalSystem.COMPOSITIONTYPE.FaultEvent_P.FaultCode, system-signal=FaultCode
        data-element=MinimalSystem.COMPOSITIONTYPE.FaultEvent_P.FaultActive, system-signal=FaultActive
        data-element=MinimalSystem.COMPOSITIONTYPE.CmdControl_R.LedCmd, system-signal=LedCmd
        data-element=MinimalSystem.COMPOSITIONTYPE.CmdControl_R.TargetMode, system-signal=TargetMode
        data-element=MinimalSystem.COMPOSITIONTYPE.CmdControl_R.Cmd_AliveCnt, system-signal=Cmd_AliveCnt
        data-element=MinimalSystem.COMPOSITIONTYPE.CmdControl_R.PwmDuty, system-signal=PwmDuty
        data-element=MinimalSystem.COMPOSITIONTYPE.CmdControl_R.Cmd_Crc8, system-signal=Cmd_Crc8
      sw-mappings:
        swc to ecu mapping SwcToEcuMapping: component=[COMPOSITIONTYPE.MinimalSystem, COMPOSITIONTYPE.IoHwAb], ecu-instance=DUT
    root-software-compositions:
      root sw composition prototype COMPOSITIONTYPE: flat-map=FLATMAP, software-composition=COMPOSITIONTYPE
