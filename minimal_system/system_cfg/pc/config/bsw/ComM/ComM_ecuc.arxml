AUTOSAR XML (schema 00046)
package /ActiveEcuC
  module config ComM: implementation-config-variant=VARIANT-PRE-COMPILE, module-description=ComM_Impl
    ComMGeneral:
      ComM0PncVectorAvoidance = false
      ComMDevErrorDetect = false
      ComMDirectUserMapping = false
      ComMModeLimitationEnabled = false
      ComMPncGatewayEnabled = false
      ComMPncSupport = false
      ComMResetAfterForcingNoComm = false
      ComMSynchronousWakeUp = true
      ComMVersionInfoApi = false
      ComMWakeupInhibitionEnabled = false
      ComMPncPrepareSleepTimer = 0
      ComMTMinFullComModeDuration = 5
      ComMEcuGroupClassification = 3
      ComMGlobalNvMBlockDescriptor = <empty>
    ComMConfigSet: ComMPncEnabled=false
      ComMUser_0 (ComMUser): ComMUserIdentifier=0
      CAN1 (ComMChannel):
        ComMFullCommRequestNotificationEnabled = false
        ComMNoCom = false
        ComMNoWakeup = false
        ComMNoWakeUpInhibitionNvmStorage = false
        ComMMainFunctionPeriod = 0.01
        ComMChannelId = 0
        ComMBusType = COMM_BUS_TYPE_CAN
        ComMPncGatewayType = COMM_GATEWAY_TYPE_ACTIVE
        ComMCDDBusPrefix = (unset)
        ComMManageReference = (unset)
        ComMNetworkManagement: ComMNmVariant=FULL, ComMPncNmRequest=false
        ComMUserPerChannel_0 (ComMUserPerChannel): ComMUserChannel=ComMUser_0
