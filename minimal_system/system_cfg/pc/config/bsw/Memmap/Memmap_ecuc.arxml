AUTOSAR XML (schema 00046)
package /ActiveEcuC
  module config Memmap
    fw (MemmapLayer): InternalLayer=true
    bsw (MemmapLayer): InternalLayer=false
    9 x MemmapModule, all with MemmapUseCalibration=false, MemmapApplicationRef=SystemApplication_Core0, MemmapUseLayer=bsw:
      Com
      Can
      CanIf
      CanSM
      ComM
      PduR
      Rte
      Crc
      Det
