AUTOSAR XML (schema 00046)
package /ActiveEcuC
  module config Can: implementation-config-variant=VARIANT-PRE-COMPILE
    CanGeneral:
      CanDevErrorDetection = false
      CanIndex = 0
      CanMainFunctionModePeriod = 0.01
      CanMultiplexedTransmission = false
      CanTimeoutDuration = 0.001
      CanVersionInfoApi = false
      CanSupportTTCANRef = CanIfPrivateCfg
      CanPcRpc: CanRpcHost=127.0.0.1, CanRpcPort=17320, CanRpcSocketPath=, CanRpcAutoReconnect=true, CanRpcReconnectIntervalMs=500
      CanMainFunctionRWPeriod_0 (CanMainFunctionRWPeriods): CanMainFunctionPeriod=0.01
    CanConfigSet
      CanController_0 (CanController):
        CanBusoffProcessing = POLLING
        CanRpcVendor = simulate
        CanRxProcessing = POLLING
        CanTxProcessing = POLLING
        CanWakeupProcessing = POLLING
        CanControllerActivation = true
        CanControllerId = 0
        CanRpcCanFd = false
        CanRpcHandle = 1
        CanWakeupFunctionalityAPI = false
        CanWakeupSupport = false
        CanControllerDefaultBaudrate = CanControllerBaudrateConfig_0
        CanControllerBaudrateConfig_0 (CanControllerBaudrateConfig):
          CanControllerBaudRate = 500
          CanControllerBaudRateConfigID = 0
          CanControllerPropSeg = 1
          CanControllerSeg1 = 12
          CanControllerSeg2 = 2
          CanControllerSyncJumpWidth = 1
      CanHardwareObject_Rx (CanHardwareObject):
        CanHandleType = BASIC
        CanIdType = STANDARD
        CanObjectType = RECEIVE
        CanHwObjectCount = 1
        CanObjectId = 1
        CanControllerRef = CanController_0
        CanMainFunctionRWPeriodRef = CanMainFunctionRWPeriod_0
        CanHwFilter_0 (CanHwFilter): CanHwFilterCode=0, CanHwFilterMask=0
      CanHardwareObject_Tx (CanHardwareObject):
        CanHandleType = BASIC
        CanIdType = STANDARD
        CanObjectType = TRANSMIT
        CanHwObjectCount = 1
        CanObjectId = 0
        CanControllerRef = CanController_0
        CanMainFunctionRWPeriodRef = CanMainFunctionRWPeriod_0
