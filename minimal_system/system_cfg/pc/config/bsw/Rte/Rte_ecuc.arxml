AUTOSAR XML (schema 00046)
package /ActiveEcuC
  module config Rte: implementation-config-variant=VARIANT-PRE-COMPILE, module-description=Rte_Impl
    RteGeneration:
      RteDevErrorDetect = false
      RteVfbTraceEnabled = false
      RteVfbTraceFunction = (unset)
      DataMappingGenerationOptimization1To1Rport = false
      DataMappingGenerationOptimizationNTo1Rport = false
      DataMappingGenerationOptimizationPport = false
      RteEaOptimization = false
      RteIsrSimplification = false
      RteSystemSignalCompuMethodEnabled = false
    RteBswGeneral
    3 x RteBswModuleInstance:
      Com: RteBswModuleConfigurationRef=Com
        3 x RteBswEventToTaskMapping, all with RteBswActivationOffset=0.0, RteBswMappedToTaskRef=OsTask_5ms, RteBswUsedOsEventRef=Rte_Ev_Cyclic2_OsTask_5ms_0_5ms:
          Com_MainFunction_TxTimingEvent0: RteBswPositionInTask=0, RteBswEventRef=Com_MainFunction_TxTimingEvent0
          Com_MainFunction_RxTimingEvent0: RteBswPositionInTask=1, RteBswEventRef=Com_MainFunction_RxTimingEvent0
          Com_MainFunction_GwTimingEvent0: RteBswPositionInTask=2, RteBswEventRef=Com_MainFunction_GwTimingEvent0
      CanSM: RteBswModuleConfigurationRef=CanSM
        CanSM_MainFunctionTimingEvent0 (RteBswEventToTaskMapping):
          RteBswActivationOffset = 0.0
          RteBswPositionInTask = 3
          RteBswEventRef = CanSM_MainFunctionTimingEvent0
          RteBswMappedToTaskRef = OsTask_5ms
          RteBswUsedOsEventRef = Rte_Ev_Cyclic2_OsTask_5ms_0_5ms
      ComM: RteBswModuleConfigurationRef=ComM
        ComM_MainFunction_CAN1TimingEvent0 (RteBswEventToTaskMapping):
          RteBswActivationOffset = 0.0
          RteBswPositionInTask = 2
          RteBswEventRef = ComM_MainFunction_CAN1TimingEvent0
          RteBswMappedToTaskRef = OsTask_10ms
          RteBswUsedOsEventRef = Rte_Ev_Cyclic2_OsTask_10ms_0_10ms
    MinimalSystem_EcuSwComposition (RteSwComponentInstance)
      SysCycleTE (RteEventToTaskMapping):
        RteActivationOffset = 0.0
        RtePositionInTask = 0
        RteEventRef = SysCycleTE
        RteMappedToTaskRef = OsTask_10ms
        RteUsedOsEventRef = Rte_Ev_MinimalSystem_SysCycleTE
    IoHwAb_EcuSwComposition (RteSwComponentInstance)
      ActCycleTE (RteEventToTaskMapping):
        RteActivationOffset = 0.0
        RtePositionInTask = 1
        RteEventRef = ActCycleTE
        RteMappedToTaskRef = OsTask_10ms
        RteUsedOsEventRef = Rte_Ev_Cyclic_OsTask_10ms_0_10ms
