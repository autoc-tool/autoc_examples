AUTOSAR XML (schema 00046)
package /COM/VCOS2/CFG/WORKFLOW/SYSDESC/SYNC
  composition sw component type COMPOSITIONTYPE  # UB:Derived from original system description
    component MinimalSystemApp: type=MinimalSystemApp
  end to end protection set E2EPROTECTIONSET
  port interface mapping set PORTINTERFACEMAPPINGSET
  system SYSTEM: category=ECU_EXTRACT
    system mapping MAPPINGS
      data-mappings:
        data-element=MinimalSystemApp.COMPOSITIONTYPE.PP_ECU_State.ECU_State, system-signal=ECU_State
        data-element=MinimalSystemApp.COMPOSITIONTYPE.PP_ECU_AliveCnt.ECU_AliveCnt, system-signal=ECU_AliveCnt
        data-element=MinimalSystemApp.COMPOSITIONTYPE.PP_Temperature.Temperature, system-signal=Temperature
        data-element=MinimalSystemApp.COMPOSITIONTYPE.PP_SupplyVoltage.SupplyVoltage, system-signal=SupplyVoltage
        data-element=MinimalSystemApp.COMPOSITIONTYPE.PP_FaultFlags.FaultFlags, system-signal=FaultFlags
        data-element=MinimalSystemApp.COMPOSITIONTYPE.PP_FaultCode.FaultCode, system-signal=FaultCode
        data-element=MinimalSystemApp.COMPOSITIONTYPE.PP_FaultActive.FaultActive, system-signal=FaultActive
        data-element=MinimalSystemApp.COMPOSITIONTYPE.RP_LedCmd.LedCmd, system-signal=LedCmd
        data-element=MinimalSystemApp.COMPOSITIONTYPE.RP_TargetMode.TargetMode, system-signal=TargetMode
        data-element=MinimalSystemApp.COMPOSITIONTYPE.RP_Cmd_AliveCnt.Cmd_AliveCnt, system-signal=Cmd_AliveCnt
        data-element=MinimalSystemApp.COMPOSITIONTYPE.RP_PwmDuty.PwmDuty, system-signal=PwmDuty
        data-element=MinimalSystemApp.COMPOSITIONTYPE.RP_Cmd_Crc8.Cmd_Crc8, system-signal=Cmd_Crc8
      sw-mappings:
        swc to ecu mapping SwcToEcuMapping: component=COMPOSITIONTYPE.MinimalSystemApp, ecu-instance=DUT
    root-software-compositions:
      root sw composition prototype COMPOSITIONTYPE: flat-map=FLATMAP, software-composition=COMPOSITIONTYPE
