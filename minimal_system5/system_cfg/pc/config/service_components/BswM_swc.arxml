AUTOSAR XML (schema 00046)
package /AUTOSAR/BswM_swc/ComponentTypes
  service sw component type BswM: category=SERVICE_COMPONENT
    behavior BswMInternalBehavior: handle-termination-and-restart=NO-SUPPORT
      timing event Timer_BswM_MainFunction: start-on-event=BswM_MainFunction, period=0.01
      runnable BswM_MainFunction
  swc implementation BswMImplementation: programming-language=C, behavior=BswMInternalBehavior
