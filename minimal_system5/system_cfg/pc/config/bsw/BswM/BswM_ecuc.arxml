AUTOSAR XML (schema 00046)
package /ActiveEcuC
  module config BswM: implementation-config-variant=VARIANT-PRE-COMPILE, module-description=BswM_Impl
    BswMGeneral:
      BswMCanSMEnabled = true
      BswMCanSMIcomEnabled = false
      BswMComMEnabled = true
      BswMDcmEnabled = true
      BswMDevErrorDetect = true
      BswMEcuMEnabled = true
      BswMEthIfEnabled = false
      BswMEthSMEnabled = true
      BswMFrSMEnabled = false
      BswMGenericRequestEnabled = true
      BswMJ1939DcmEnabled = false
      BswMJ1939NmEnabled = false
      BswMLinSMEnabled = false
      BswMLinTPEnabled = false
      BswMNmEnabled = false
      BswMNvMEnabled = true
      BswMSchMEnabled = false
      BswMSdEnabled = false
      BswMVersionInfoApi = true
      BswMWdgMEnabled = false
      BswMMainFunctionPeriod = 0.01
    BswMConfig: BswMPartitionRef=<empty>
      BswMArbitration
        11 x BswMRule, all with BswMRuleInitState=BSWM_FALSE:
          ECUM_ModuleInit: BswMNestedExecutionOnly=false, BswMRuleExpressionRef=/ActiveEcuC/BswM/BswMConfig/BswMArbitration/ECUM_LE_INIT, BswMRuleFalseActionList=, BswMRuleTrueActionList=/ActiveEcuC/BswM/BswMConfig/BswMModeControl/ECUM_AL_INIT
          ESH_InitToWakeup: BswMNestedExecutionOnly=false, BswMRuleExpressionRef=/ActiveEcuC/BswM/BswMConfig/BswMArbitration/ESH_LE_InitToWakeup, BswMRuleFalseActionList=, BswMRuleTrueActionList=/ActiveEcuC/BswM/BswMConfig/BswMModeControl/ESH_AL_InitToWakeup
          ESH_WakeupToRun: BswMNestedExecutionOnly=false, BswMRuleExpressionRef=/ActiveEcuC/BswM/BswMConfig/BswMArbitration/ESH_LE_WakeupToRun, BswMRuleFalseActionList=, BswMRuleTrueActionList=/ActiveEcuC/BswM/BswMConfig/BswMModeControl/ESH_AL_WakeupToRun
          ESH_RunToPostRun: BswMNestedExecutionOnly=false, BswMRuleExpressionRef=/ActiveEcuC/BswM/BswMConfig/BswMArbitration/ESH_LE_RunToPostRun, BswMRuleFalseActionList=, BswMRuleTrueActionList=/ActiveEcuC/BswM/BswMConfig/BswMModeControl/ESH_AL_RunToPostRun
          ESH_PostRun: BswMNestedExecutionOnly=false, BswMRuleExpressionRef=/ActiveEcuC/BswM/BswMConfig/BswMArbitration/ESH_LE_PostRun, BswMRuleFalseActionList=, BswMRuleTrueActionList=/ActiveEcuC/BswM/BswMConfig/BswMModeControl/ESH_AL_ExitPostRun
          ESH_PostRunNested: BswMNestedExecutionOnly=true, BswMRuleExpressionRef=/ActiveEcuC/BswM/BswMConfig/BswMArbitration/ESH_LE_PostRunToRun, BswMRuleFalseActionList=/ActiveEcuC/BswM/BswMConfig/BswMModeControl/ESH_AL_ESH_PostRunToPrepCheck, BswMRuleTrueActionList=/ActiveEcuC/BswM/BswMConfig/BswMModeControl/ESH_AL_WakeupToRun
          ESH_PostRunToPrepNested: BswMNestedExecutionOnly=true, BswMRuleExpressionRef=/ActiveEcuC/BswM/BswMConfig/BswMArbitration/ESH_LE_PostRunToPrep, BswMRuleFalseActionList=, BswMRuleTrueActionList=/ActiveEcuC/BswM/BswMConfig/BswMModeControl/ESH_AL_PostRunToPrep
          ESH_WakeupToPrep: BswMNestedExecutionOnly=false, BswMRuleExpressionRef=/ActiveEcuC/BswM/BswMConfig/BswMArbitration/ESH_LE_WakeupToPrep, BswMRuleFalseActionList=, BswMRuleTrueActionList=/ActiveEcuC/BswM/BswMConfig/BswMModeControl/ESH_AL_PostRunToPrep
          ESH_PrepToWait: BswMNestedExecutionOnly=false, BswMRuleExpressionRef=/ActiveEcuC/BswM/BswMConfig/BswMArbitration/ESH_LE_PrepToWait, BswMRuleFalseActionList=, BswMRuleTrueActionList=/ActiveEcuC/BswM/BswMConfig/BswMModeControl/ESH_AL_PrepToWait
          ESH_WaitToWakeup: BswMNestedExecutionOnly=false, BswMRuleExpressionRef=/ActiveEcuC/BswM/BswMConfig/BswMArbitration/ESH_LE_WaitToWakeup, BswMRuleFalseActionList=, BswMRuleTrueActionList=/ActiveEcuC/BswM/BswMConfig/BswMModeControl/ESH_AL_WaitToWakeup
          ESH_WaitToShutdown: BswMNestedExecutionOnly=false, BswMRuleExpressionRef=/ActiveEcuC/BswM/BswMConfig/BswMArbitration/ESH_LE_WaitToShutdown, BswMRuleFalseActionList=, BswMRuleTrueActionList=/ActiveEcuC/BswM/BswMConfig/BswMModeControl/ESH_AL_WaitToShutdown
        7 x BswMModeRequestPort:
          EcuM_GetStateReq: BswMRequestProcessing=BSWM_IMMEDIATE
            BswMModeRequestSource
              BswMUserConditionRequest: User Condition=BswM_EcuM_GetState()
            BswMModeInitValue: BswMBswModeInitValue=BSWM_UNDEFINED_REQUEST_VALUE
          ESH_EcuM_GetPendingWakeupEvents: BswMRequestProcessing=BSWM_DEFERRED
            BswMModeRequestSource
              BswMUserConditionRequest: User Condition=EcuM_GetPendingWakeupEvents()
            BswMModeInitValue: BswMBswModeInitValue=BSWM_UNDEFINED_REQUEST_VALUE
          ESH_EcuM_GetValidatedWakeupEvents: BswMRequestProcessing=BSWM_DEFERRED
            BswMModeRequestSource
              BswMUserConditionRequest: User Condition=EcuM_GetValidatedWakeupEvents()
            BswMModeInitValue: BswMBswModeInitValue=BSWM_UNDEFINED_REQUEST_VALUE
          ESH_SelfRunRequestTimer: BswMRequestProcessing=BSWM_DEFERRED
            BswMModeRequestSource
              ESH_SelfRunRequestTimer (BswMTimer)
            BswMModeInitValue: BswMBswModeInitValue=BSWM_TIMER_STOPPED
          ESH_RunRequest_1: BswMRequestProcessing=BSWM_DEFERRED
            BswMModeRequestSource
              BswMUserConditionRequest: User Condition=hasRunRequests()
            BswMModeInitValue: BswMBswModeInitValue=FALSE
          ESH_PostRunRequest_1: BswMRequestProcessing=BSWM_DEFERRED
            BswMModeRequestSource
              BswMUserConditionRequest: User Condition=hasPostRunRequests()
            BswMModeInitValue: BswMBswModeInitValue=FALSE
          ESH_NvM_WriteAllTimer: BswMRequestProcessing=BSWM_DEFERRED
            BswMModeRequestSource
              ESH_NvM_WriteAllTimer (BswMTimer)
            BswMModeInitValue: BswMBswModeInitValue=BSWM_TIMER_STOPPED
        13 x BswMModeCondition:
          ECUM_CO_INIT: BswMConditionType=BSWM_EQUALS, BswMConditionMode=/ActiveEcuC/BswM/BswMConfig/BswMArbitration/EcuM_GetStateReq
            BswMConditionValue
              BswMBswMode: BswMBswRequestedMode=ECUM_STATE_STARTUP_TWO
          ESH_CO_InitToWakeup: BswMConditionType=BSWM_EQUALS, BswMConditionMode=/ActiveEcuC/BswM/BswMConfig/BswMArbitration/ESH_State
            BswMConditionValue
              BswMBswMode: BswMBswRequestedMode=BSWM_ESH_INIT
          ESH_CO_WakeupToRun1: BswMConditionType=BSWM_EQUALS, BswMConditionMode=/ActiveEcuC/BswM/BswMConfig/BswMArbitration/ESH_State
            BswMConditionValue
              BswMBswMode: BswMBswRequestedMode=BSWM_ESH_WAKEUP
          ESH_CO_WakeupToRun2: BswMConditionType=BSWM_EQUALS_NOT, BswMConditionMode=/ActiveEcuC/BswM/BswMConfig/BswMArbitration/ESH_EcuM_GetValidatedWakeupEvents
            BswMConditionValue
              BswMBswMode: BswMBswRequestedMode=0U
          ESH_CO_RunToPostRun1: BswMConditionType=BSWM_EQUALS, BswMConditionMode=/ActiveEcuC/BswM/BswMConfig/BswMArbitration/ESH_State
            BswMConditionValue
              BswMBswMode: BswMBswRequestedMode=BSWM_ESH_RUN
          ESH_CO_RunToPostRun2: BswMConditionType=BSWM_EQUALS, BswMConditionMode=/ActiveEcuC/BswM/BswMConfig/BswMArbitration/ESH_RunRequest_1
            BswMConditionValue
              BswMBswMode: BswMBswRequestedMode=FALSE
          ESH_CO_RunToPostRun3: BswMConditionType=BSWM_EQUALS, BswMConditionMode=/ActiveEcuC/BswM/BswMConfig/BswMArbitration/ESH_SelfRunRequestTimer
            BswMConditionValue
              BswMBswMode: BswMBswRequestedMode=BSWM_TIMER_EXPIRED
          ESH_CO_PostRun: BswMConditionType=BSWM_EQUALS, BswMConditionMode=/ActiveEcuC/BswM/BswMConfig/BswMArbitration/ESH_State
            BswMConditionValue
              BswMBswMode: BswMBswRequestedMode=BSWM_ESH_POST_RUN
          ESH_CO_PostRunToRun2: BswMConditionType=BSWM_EQUALS, BswMConditionMode=/ActiveEcuC/BswM/BswMConfig/BswMArbitration/ESH_RunRequest_1
            BswMConditionValue
              BswMBswMode: BswMBswRequestedMode=TRUE
          ESH_CO_PostRunToPrep: BswMConditionType=BSWM_EQUALS, BswMConditionMode=/ActiveEcuC/BswM/BswMConfig/BswMArbitration/ESH_PostRunRequest_1
            BswMConditionValue
              BswMBswMode: BswMBswRequestedMode=FALSE
          ESH_CO_WakeupToPrep1: BswMConditionType=BSWM_EQUALS, BswMConditionMode=/ActiveEcuC/BswM/BswMConfig/BswMArbitration/ESH_EcuM_GetValidatedWakeupEvents
            BswMConditionValue
              BswMBswMode: BswMBswRequestedMode=0U
          ESH_CO_PrepToWait: BswMConditionType=BSWM_EQUALS, BswMConditionMode=/ActiveEcuC/BswM/BswMConfig/BswMArbitration/ESH_State
            BswMConditionValue
              BswMBswMode: BswMBswRequestedMode=BSWM_ESH_PREP_SHUTDOWN
          ESH_CO_Wait: BswMConditionType=BSWM_EQUALS, BswMConditionMode=/ActiveEcuC/BswM/BswMConfig/BswMArbitration/ESH_State
            BswMConditionValue
              BswMBswMode: BswMBswRequestedMode=BSWM_ESH_WAIT_FOR_NVM
        11 x BswMLogicalExpression:
          ECUM_LE_INIT: BswMLogicalOperator=BSWM_AND, BswMArgumentRef=/ActiveEcuC/BswM/BswMConfig/BswMArbitration/ECUM_CO_INIT
          ESH_LE_InitToWakeup: BswMLogicalOperator=BSWM_AND, BswMArgumentRef=/ActiveEcuC/BswM/BswMConfig/BswMArbitration/ESH_CO_InitToWakeup
          ESH_LE_WakeupToRun: BswMLogicalOperator=BSWM_AND, BswMArgumentRef=/ActiveEcuC/BswM/BswMConfig/BswMArbitration/ESH_CO_WakeupToRun1, BswMArgumentRef=/ActiveEcuC/BswM/BswMConfig/BswMArbitration/ESH_CO_WakeupToRun2
          ESH_LE_RunToPostRun: BswMLogicalOperator=BSWM_AND, BswMArgumentRef=/ActiveEcuC/BswM/BswMConfig/BswMArbitration/ESH_CO_RunToPostRun1, BswMArgumentRef=/ActiveEcuC/BswM/BswMConfig/BswMArbitration/ESH_CO_RunToPostRun2, BswMArgumentRef=/ActiveEcuC/BswM/BswMConfig/BswMArbitration/ESH_CO_RunToPostRun3
          ESH_LE_PostRun: BswMLogicalOperator=BSWM_AND, BswMArgumentRef=/ActiveEcuC/BswM/BswMConfig/BswMArbitration/ESH_CO_PostRun
          ESH_LE_PostRunToRun: BswMLogicalOperator=BSWM_OR, BswMArgumentRef=/ActiveEcuC/BswM/BswMConfig/BswMArbitration/ESH_CO_PostRunToRun2, BswMArgumentRef=/ActiveEcuC/BswM/BswMConfig/BswMArbitration/ESH_CO_WakeupToRun2
          ESH_LE_PostRunToPrep: BswMLogicalOperator=BSWM_AND, BswMArgumentRef=/ActiveEcuC/BswM/BswMConfig/BswMArbitration/ESH_CO_PostRunToPrep
          ESH_LE_WakeupToPrep: BswMLogicalOperator=BSWM_AND, BswMArgumentRef=/ActiveEcuC/BswM/BswMConfig/BswMArbitration/ESH_CO_WakeupToRun1, BswMArgumentRef=/ActiveEcuC/BswM/BswMConfig/BswMArbitration/ESH_CO_WakeupToPrep1
          ESH_LE_PrepToWait: BswMLogicalOperator=BSWM_AND, BswMArgumentRef=/ActiveEcuC/BswM/BswMConfig/BswMArbitration/ESH_CO_PrepToWait
          ESH_LE_WaitToWakeup: BswMLogicalOperator=BSWM_AND, BswMArgumentRef=/ActiveEcuC/BswM/BswMConfig/BswMArbitration/ESH_CO_Wait, BswMArgumentRef=/ActiveEcuC/BswM/BswMConfig/BswMArbitration/ESH_CO_WakeupToRun2
          ESH_LE_WaitToShutdown: BswMLogicalOperator=BSWM_AND, BswMArgumentRef=/ActiveEcuC/BswM/BswMConfig/BswMArbitration/ESH_CO_Wait, BswMArgumentRef=/ActiveEcuC/BswM/BswMConfig/BswMArbitration/ESH_CO_WakeupToPrep1
        ESH_State (BswMModeRequestPort): BswMRequestProcessing=BSWM_IMMEDIATE
          BswMModeRequestSource
            BswMGenericRequest: BswMModeRequesterId=1
          BswMModeInitValue: BswMBswModeInitValue=BSWM_ESH_INIT
        StartCommunicationRule (BswMRule):
          BswMNestedExecutionOnly = false
          BswMRuleInitState = BSWM_FALSE
          BswMRuleExpressionRef = /ActiveEcuC/BswM/BswMConfig/BswMArbitration/StartCommunicationExp
          BswMRuleFalseActionList = 
          BswMRuleTrueActionList = /ActiveEcuC/BswM/BswMConfig/BswMModeControl/StartCommunicationList
        KeepComRule (BswMRule):
          BswMNestedExecutionOnly = false
          BswMRuleInitState = BSWM_TRUE
          BswMRuleExpressionRef = /ActiveEcuC/BswM/BswMConfig/BswMArbitration/KeepComExp
          BswMRuleFalseActionList = /ActiveEcuC/BswM/BswMConfig/BswMModeControl/ReqNocomList
          BswMRuleTrueActionList = /ActiveEcuC/BswM/BswMConfig/BswMModeControl/ReqFullcomList
        StartCommunicationExp (BswMLogicalExpression): BswMLogicalOperator=BSWM_NOT, BswMArgumentRef=/ActiveEcuC/BswM/BswMConfig/BswMArbitration/Condition2
        KeepComExp (BswMLogicalExpression): BswMLogicalOperator=BSWM_AND, BswMArgumentRef=/ActiveEcuC/BswM/BswMConfig/BswMArbitration/Condition22
        Condition2 (BswMModeCondition): BswMConditionType=BSWM_EQUALS_NOT, BswMConditionMode=/ActiveEcuC/BswM/BswMConfig/BswMArbitration/StartCommunicationReq
          BswMConditionValue
            BswMBswMode: BswMBswRequestedMode=BSWM_UNDEFINED_REQUEST_VALUE
        Condition22 (BswMModeCondition): BswMConditionType=BSWM_EQUALS, BswMConditionMode=/ActiveEcuC/BswM/BswMConfig/BswMArbitration/KeepComReq
          BswMConditionValue
            BswMBswMode: BswMBswRequestedMode=COMM_FULL_COMMUNICATION
        3 x BswMModeRequestPort:
          KeepComReq: BswMRequestProcessing=BSWM_IMMEDIATE
            BswMModeRequestSource
            BswMModeInitValue: BswMBswModeInitValue=COMM_FULL_COMMUNICATION
          BswCommIndicationReq: BswMRequestProcessing=BSWM_DEFERRED
            BswMModeRequestSource
            BswMModeInitValue: BswMBswModeInitValue=COMM_NO_COMMUNICATION
          StartCommunicationReq: BswMRequestProcessing=BSWM_DEFERRED
            BswMModeRequestSource
            BswMModeInitValue: BswMBswModeInitValue=BSWM_UNDEFINED_REQUEST_VALUE
      BswMModeControl
        11 x BswMAction:
          ECUM_Action_BSW_InitTwo
            BswMAvailableActions
              BswMEcuMDriverInitListBswM: BswMEcuMDriverInitListBswMRef=/ActiveEcuC/EcuM/EcuMConfiguration/EcuMFlexConfiguration/EcuMDriverInitListTwo
          ECUM_Action_BSW_InitThree
            BswMAvailableActions
              BswMEcuMDriverInitListBswM: BswMEcuMDriverInitListBswMRef=/ActiveEcuC/EcuM/EcuMConfiguration/EcuMFlexConfiguration/EcuMDriverInitListThree
          ECUM_Action_RTE_Init
            BswMAvailableActions
              BswMUserCallout: BswMUserCalloutFunction=BswM_SchM_Rte_Init()
          ESH_Action_SelfRunRequestTimer_Start
            BswMAvailableActions
              BswMTimerControl:
                BswMTimerValue = 500
                BswMTimerAction = BSWM_TIMER_START
                BswMTimerRef = /ActiveEcuC/BswM/BswMConfig/BswMArbitration/ESH_SelfRunRequestTimer/BswMModeRequestSource/ESH_SelfRunRequestTimer
          ESH_Action_WriteAllTimer_Stop
            BswMAvailableActions
              BswMTimerControl:
                BswMTimerValue = 0
                BswMTimerAction = BSWM_TIMER_START
                BswMTimerRef = /ActiveEcuC/BswM/BswMConfig/BswMArbitration/ESH_NvM_WriteAllTimer/BswMModeRequestSource/ESH_NvM_WriteAllTimer
          ESH_Action_WriteAllTimer_Start
            BswMAvailableActions
              BswMTimerControl:
                BswMTimerValue = 1000
                BswMTimerAction = BSWM_TIMER_START
                BswMTimerRef = /ActiveEcuC/BswM/BswMConfig/BswMArbitration/ESH_NvM_WriteAllTimer/BswMModeRequestSource/ESH_NvM_WriteAllTimer
          ESH_Action_ESH_Wakeup
            BswMAvailableActions
              BswMUserCallout: BswMUserCalloutFunction=BswM_RequestMode(BSWM_ESH_User, BSWM_ESH_WAKEUP)
          ESH_Action_ESH_Run
            BswMAvailableActions
              BswMUserCallout: BswMUserCalloutFunction=BswM_ESH_EnterRun()
          ESH_Action_ESH_PostRun
            BswMAvailableActions
              BswMUserCallout: BswMUserCalloutFunction=BswM_ESH_RunToPostRun()
          ESH_Action_ESH_Prep
            BswMAvailableActions
              BswMUserCallout: BswMUserCalloutFunction=BswM_RequestMode(BSWM_ESH_User, BSWM_ESH_PREP_SHUTDOWN)
          ESH_Action_ESH_Wait
            BswMAvailableActions
              BswMUserCallout: BswMUserCalloutFunction=BswM_ESH_EnterWait()
        11 x BswMActionList:
          ECUM_AL_INIT: BswMActionListExecution=BSWM_TRIGGER
            3 x BswMActionListItem, all with BswMAbortOnFail=false, BswMReportFailRuntimeErrorId=128:
              BswMActionListItem: BswMActionListItemIndex=0, BswMActionListItemRef=/ActiveEcuC/BswM/BswMConfig/BswMModeControl/ECUM_Action_BSW_InitTwo
              BswMActionListItem_1: BswMActionListItemIndex=1, BswMActionListItemRef=/ActiveEcuC/BswM/BswMConfig/BswMModeControl/ECUM_Action_BSW_InitThree
              BswMActionListItem_2: BswMActionListItemIndex=2, BswMActionListItemRef=/ActiveEcuC/BswM/BswMConfig/BswMModeControl/ECUM_Action_RTE_Init
          ESH_AL_InitToWakeup: BswMActionListExecution=BSWM_CONDITION
            BswMActionListItem:
              BswMAbortOnFail = false
              BswMActionListItemIndex = 0
              BswMReportFailRuntimeErrorId = 128
              BswMActionListItemRef = /ActiveEcuC/BswM/BswMConfig/BswMModeControl/ESH_Action_ESH_Wakeup
          ESH_AL_WakeupToRun: BswMActionListExecution=BSWM_CONDITION
            BswMActionListItem:
              BswMAbortOnFail = false
              BswMActionListItemIndex = 0
              BswMReportFailRuntimeErrorId = 128
              BswMActionListItemRef = /ActiveEcuC/BswM/BswMConfig/BswMModeControl/ESH_Action_ESH_Run
            BswMActionListItem_1 (BswMActionListItem):
              BswMAbortOnFail = false
              BswMActionListItemIndex = 1
              BswMReportFailRuntimeErrorId = 128
              BswMActionListItemRef = /ActiveEcuC/BswM/BswMConfig/BswMModeControl/ESH_Action_SelfRunRequestTimer_Start
          ESH_AL_RunToPostRun: BswMActionListExecution=BSWM_CONDITION
            BswMActionListItem:
              BswMAbortOnFail = false
              BswMActionListItemIndex = 0
              BswMReportFailRuntimeErrorId = 128
              BswMActionListItemRef = /ActiveEcuC/BswM/BswMConfig/BswMModeControl/ESH_Action_ESH_PostRun
          ESH_AL_ExitPostRun: BswMActionListExecution=BSWM_CONDITION
            BswMActionListItem:
              BswMAbortOnFail = false
              BswMActionListItemIndex = 0
              BswMReportFailRuntimeErrorId = 128
              BswMActionListItemRef = /ActiveEcuC/BswM/BswMConfig/BswMArbitration/ESH_PostRunNested
          ESH_AL_PostRunToRun: BswMActionListExecution=BSWM_CONDITION
            BswMActionListItem:
              BswMAbortOnFail = false
              BswMActionListItemIndex = 0
              BswMReportFailRuntimeErrorId = 128
              BswMActionListItemRef = /ActiveEcuC/BswM/BswMConfig/BswMModeControl/ESH_Action_ESH_Run
          ESH_AL_ESH_PostRunToPrepCheck: BswMActionListExecution=BSWM_CONDITION
            BswMActionListItem:
              BswMAbortOnFail = false
              BswMActionListItemIndex = 0
              BswMReportFailRuntimeErrorId = 128
              BswMActionListItemRef = /ActiveEcuC/BswM/BswMConfig/BswMArbitration/ESH_PostRunToPrepNested
          ESH_AL_PostRunToPrep: BswMActionListExecution=BSWM_CONDITION
            BswMActionListItem:
              BswMAbortOnFail = false
              BswMActionListItemIndex = 0
              BswMReportFailRuntimeErrorId = 128
              BswMActionListItemRef = /ActiveEcuC/BswM/BswMConfig/BswMModeControl/ESH_Action_ESH_Prep
          ESH_AL_PrepToWait: BswMActionListExecution=BSWM_CONDITION
            BswMActionListItem:
              BswMAbortOnFail = false
              BswMActionListItemIndex = 0
              BswMReportFailRuntimeErrorId = 128
              BswMActionListItemRef = /ActiveEcuC/BswM/BswMConfig/BswMModeControl/ESH_Action_WriteAllTimer_Start
            BswMActionListItem_1 (BswMActionListItem):
              BswMAbortOnFail = false
              BswMActionListItemIndex = 1
              BswMReportFailRuntimeErrorId = 128
              BswMActionListItemRef = /ActiveEcuC/BswM/BswMConfig/BswMModeControl/ESH_Action_ESH_Wait
          ESH_AL_WaitToWakeup: BswMActionListExecution=BSWM_CONDITION
            BswMActionListItem:
              BswMAbortOnFail = false
              BswMActionListItemIndex = 0
              BswMReportFailRuntimeErrorId = 128
              BswMActionListItemRef = /ActiveEcuC/BswM/BswMConfig/BswMModeControl/ESH_Action_WriteAllTimer_Stop
            BswMActionListItem_1 (BswMActionListItem):
              BswMAbortOnFail = false
              BswMActionListItemIndex = 1
              BswMReportFailRuntimeErrorId = 128
              BswMActionListItemRef = /ActiveEcuC/BswM/BswMConfig/BswMModeControl/ESH_Action_ESH_WaitToWakeup
          ESH_AL_WaitToShutdown: BswMActionListExecution=BSWM_CONDITION
            BswMActionListItem:
              BswMAbortOnFail = false
              BswMActionListItemIndex = 0
              BswMReportFailRuntimeErrorId = 128
              BswMActionListItemRef = /ActiveEcuC/BswM/BswMConfig/BswMModeControl/ESH_Action_WriteAllTimer_Stop
            BswMActionListItem_1 (BswMActionListItem):
              BswMAbortOnFail = false
              BswMActionListItemIndex = 1
              BswMReportFailRuntimeErrorId = 128
              BswMActionListItemRef = /ActiveEcuC/BswM/BswMConfig/BswMModeControl/ESH_Action_ESH_Shutdown
        3 x BswMAction:
          ESH_Action_ESH_WaitToWakeup
            BswMAvailableActions
              BswMUserCallout: BswMUserCalloutFunction=BswM_ESH_WaitToWakeup()
          ESH_Action_ESH_Shutdown
            BswMAvailableActions
              BswMUserCallout: BswMUserCalloutFunction=BswM_RequestMode(BSWM_ESH_User, BSWM_ESH_SHUTDOWN)
          ReqFullcomAction
            BswMAvailableActions
              BswMUserCallout: BswMUserCalloutFunction=BswM_RequestFullCom()
        ReqFullcomList (BswMActionList): BswMActionListExecution=BSWM_TRIGGER
          BswMActionListItem:
            BswMAbortOnFail = false
            BswMActionListItemIndex = 0
            BswMReportFailRuntimeErrorId = 128
            BswMActionListItemRef = /ActiveEcuC/BswM/BswMConfig/BswMModeControl/ReqFullcomAction
        ReqNocomAction (BswMAction)
          BswMAvailableActions
            BswMUserCallout: BswMUserCalloutFunction=BswM_RequestNoCom()
        RequestFullcomAction (BswMAction)
          BswMAvailableActions
            BswMUserCallout: BswMUserCalloutFunction=ReqFullcom_callout()
        ReqNocomList (BswMActionList): BswMActionListExecution=BSWM_TRIGGER
          BswMActionListItem:
            BswMAbortOnFail = false
            BswMActionListItemIndex = 0
            BswMReportFailRuntimeErrorId = 128
            BswMActionListItemRef = /ActiveEcuC/BswM/BswMConfig/BswMModeControl/ReqNocomAction
        StartCommunicationList (BswMActionList): BswMActionListExecution=BSWM_TRIGGER
          BswMActionListItem:
            BswMAbortOnFail = false
            BswMActionListItemIndex = 0
            BswMReportFailRuntimeErrorId = 128
            BswMActionListItemRef = /ActiveEcuC/BswM/BswMConfig/BswMModeControl/RequestFullcomAction
      BswMDataTypeMappingSets: BswMDataTypeMappingSetRef=
