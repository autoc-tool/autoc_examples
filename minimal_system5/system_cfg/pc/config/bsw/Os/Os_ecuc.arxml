AUTOSAR XML (schema 00046)
package /ActiveEcuC
  module config Os: implementation-config-variant=VARIANT-PRE-COMPILE, module-description=Os_Impl
    OSDEFAULTAPPMODE (OsAppMode)
    OSAUTOSTARTMODE (OsAppMode)
    SystemApplication_Core0 (OsApplication):
      OsIsPrivileged = true
      OsAppMemoryProtectionIdentifier = (unset)
      OsAppCounterRef = OsCounter_System
      OsAppEcucPartitionRef = /ActiveEcuC/EcuC/EcucPartitionCollection/EcucPartition_0
      OsAppIsrRef = (unset)
      OsApplicationCoreRef = /ActiveEcuC/EcuC/EcucHardware/EcucCoreDefinition0
      OsAppScheduleTableRef = (unset)
      OsAppTaskRef = /ActiveEcuC/Os/core0_shell
      OsAppTaskRef = OsTask_Init
      OsAppTaskRef = OsTask_10ms
      OsAppTaskRef = OsTask_100ms
    core0_shell (OsTask):
      OsTaskUsesFpu = true
      OsTaskActivation = 1
      OsTaskPriority = 10
      OsTaskStackSize = 4096
      OsTaskType = EXTENDED
      OsTaskSchedule = FULL
      OsTaskEventRef = (unset)
      OsTaskAccessingApplication = /ActiveEcuC/Os/SystemApplication_Core0
      OsTaskResourceRef = (unset)
      OsTaskAutostart: OsTaskAppModeRef=/ActiveEcuC/Os/OSAUTOSTARTMODE
    OsCore0 (OsCore): OsCoreBswApplicationRef=/ActiveEcuC/Os/SystemApplication_Core0, OsCoreEcucIdRef=EcucCoreDefinition0
    OsPublishedInformation: OsKernelVersion=4.4.0, OsPlatformName=PC
      OsDerivativeInformation
        OsPhysicalCore0 (OsPhysicalCore): OsPhysicalCoreId=0
    3 x OsTask, all with OsTaskActivation=1, OsTaskStackSize=2048, OsTaskUsesFpu=false, OsTaskSchedule=FULL, OsTaskType=EXTENDED, OsTaskAccessingApplication=SystemApplication_Core0:
      OsTask_Init: OsTaskPriority=1, OsTaskEventRef=Rte_Ev_Run_MinimalSystemApp_RE_Init
        OsTaskAutostart: OsTaskAppModeRef=OSAUTOSTARTMODE
      OsTask_10ms: OsTaskPriority=2, OsTaskEventRef=Rte_Ev_Cyclic2_OsTask_10ms_0_10ms
      OsTask_100ms: OsTaskPriority=3, OsTaskEventRef=Rte_Ev_Cyclic_OsTask_100ms_0_100ms
    OsCounter_System (OsCounter): OsCounterMaxAllowedValue=1073741823, OsCounterMinCycle=1, OsSecondsPerTick=0.001, OsCounterType=SOFTWARE
    4 x OsEvent:
      Rte_Ev_Cyclic2_OsTask_10ms_0_10ms
      Rte_Ev_Cyclic_OsTask_10ms_0_10ms
      Rte_Ev_Cyclic_OsTask_100ms_0_100ms
      Rte_Ev_Run_MinimalSystemApp_RE_Init
