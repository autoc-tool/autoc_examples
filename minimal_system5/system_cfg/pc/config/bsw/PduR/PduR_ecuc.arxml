AUTOSAR XML (schema 00046)
package /ActiveEcuC
  module config PduR: implementation-config-variant=VARIANT-PRE-COMPILE, module-description=PduR_Impl
    PduRGeneral: PduRDevErrorDetect=false, PduRMetaDataSupport=false, PduRSpinlockRetryCounter=3, PduRVersionInfoApi=false, PduRZeroCostOperation=false
    PduRRoutingPaths: PduRConfigurationId=0, PduRMaxRoutingPathCnt=65535, PduRMaxRoutingPathGroupCnt=65535
      3 x PduRDestPdu, all with PduRDestPduDataProvision=PDUR_DIRECT:
        Cmd_Control_Rx_Dest: PduRTransmissionConfirmation=false, PduRDestPduHandleId=0, PduRDestPduRef=Cmd_Control
        ECU_Status_Tx_Dest: PduRTransmissionConfirmation=true, PduRDestPduHandleId=1, PduRDestPduRef=ECU_Status
        Fault_Event_Tx_Dest: PduRTransmissionConfirmation=true, PduRDestPduHandleId=2, PduRDestPduRef=Fault_Event
      3 x PduRRoutingPath:
        Cmd_Control_Rx: PduRSrcPduRRef=Cmd_Control_Rx_Src, PduRDestPduRRef=Cmd_Control_Rx_Dest
        ECU_Status_Tx: PduRSrcPduRRef=ECU_Status_Tx_Src, PduRDestPduRRef=ECU_Status_Tx_Dest
        Fault_Event_Tx: PduRSrcPduRRef=Fault_Event_Tx_Src, PduRDestPduRRef=Fault_Event_Tx_Dest
      3 x PduRSrcPdu:
        Cmd_Control_Rx_Src: PduRSourcePduHandleId=0, PduRSrcPduUpTxConf=false, PduRSrcPduRef=Cmd_Control
        ECU_Status_Tx_Src: PduRSourcePduHandleId=1, PduRSrcPduUpTxConf=true, PduRSrcPduRef=ECU_Status
        Fault_Event_Tx_Src: PduRSourcePduHandleId=2, PduRSrcPduUpTxConf=true, PduRSrcPduRef=Fault_Event
    CanIf (PduRBswModules):
      PduRCancelReceive = true
      PduRCancelTransmit = true
      PduRCommunicationInterface = true
      PduRLowerModule = true
      PduRRetransmission = false
      PduRTransportProtocol = false
      PduRTriggertransmit = true
      PduRTxConfirmation = true
      PduRUpperModule = false
      PduRUseTag = false
      PduRBswModuleRef = CanIf
    Com (PduRBswModules):
      PduRCancelReceive = true
      PduRCancelTransmit = true
      PduRCommunicationInterface = true
      PduRLowerModule = false
      PduRRetransmission = false
      PduRTransportProtocol = false
      PduRTriggertransmit = true
      PduRTxConfirmation = false
      PduRUpperModule = true
      PduRUseTag = false
      PduRBswModuleRef = Com
