AUTOSAR XML (schema 00046)
package /ActiveEcuC
  module config Can: implementation-config-variant=VARIANT-PRE-COMPILE
    CanGeneral:
      CanDevErrorDetection = false
      CanIndex = 0
      CanMainFunctionModePeriod = 0.01
      CanMultiplexedTransmission = false
      CanTimeoutDuration = 0.001
      CanVersionInfoApi = false
      CanSupportTTCANRef = CanIfPrivateCfg
      CanPcRpc: CanRpcHost=127.0.0.1, CanRpcPort=17320, CanRpcSocketPath=, CanRpcAutoReconnect=true, CanRpcReconnectIntervalMs=500
    CanConfigSet
      CanController_0 (CanController):
        CanBusoffProcessing = POLLING
        CanRpcVendor = simulate
        CanRxProcessing = POLLING
        CanTxProcessing = POLLING
        CanWakeupProcessing = POLLING
        HardwareName = SIM-CAN-1
        CanControllerActivation = true
        CanControllerId = 0
        CanRpcCanFd = false
        CanRpcHandle = 1
        CanWakeupFunctionalityAPI = false
        CanWakeupSupport = false
        CanControllerDefaultBaudrate = CanControllerBaudrateConfig_0
        CanControllerBaudrateConfig_0 (CanControllerBaudrateConfig):
          CanControllerBaudRate = 500
          CanControllerBaudRateConfigID = 0
          CanControllerPropSeg = 2
          CanControllerSeg1 = 10
          CanControllerSeg2 = 3
          CanControllerSyncJumpWidth = 3
      CanHardwareObject_0 (CanHardwareObject): CanHandleType=BASIC, CanIdType=STANDARD, CanObjectType=TRANSMIT, CanHwObjectCount=1, CanObjectId=0, CanControllerRef=CanController_0
      CanHardwareObject_1 (CanHardwareObject): CanHandleType=BASIC, CanIdType=STANDARD, CanObjectType=RECEIVE, CanHwObjectCount=1, CanObjectId=1, CanControllerRef=CanController_0
