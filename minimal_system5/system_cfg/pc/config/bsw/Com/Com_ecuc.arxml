AUTOSAR XML (schema 00046)
package /ActiveEcuC
  module config Com: implementation-config-variant=VARIANT-PRE-COMPILE, module-description=Com_Impl
    ComConfig: ComDataMemSize=0, ComMaxIPduCnt=0
      Com_MainFunction_Rx (ComMainFunctionRx): MainRxTimeBase=0.005
      Com_MainFunction_Tx (ComMainFunctionTx): MainTxTimeBase=0.005
      Com_MainFunction_Gw (ComMainFunctionGw): MainGwTimeBase=0.005
      3 x ComIPdu, all with ComIPduSignalProcessing=DEFERRED, ComIPduType=NORMAL, ComIPduGroupRef=ComIPduGroup_0:
        Cmd_Control: ComIPduDirection=RECEIVE, ComIPduHandleId=0, ComIPduSignalRef=LedCmd_o_Cmd_Control_Rx, ComIPduSignalRef=TargetMode_o_Cmd_Control_Rx, ComIPduSignalRef=Cmd_AliveCnt_o_Cmd_Control_Rx, ComIPduSignalRef=PwmDuty_o_Cmd_Control_Rx, ComIPduSignalRef=Cmd_Crc8_o_Cmd_Control_Rx, ComPduIdRef=Cmd_Control, IPduMainFunctionRef=Com_MainFunction_Rx
        ECU_Status: ComIPduDirection=SEND, ComIPduHandleId=1, ComIPduSignalRef=ECU_State_o_ECU_Status_Tx, ComIPduSignalRef=ECU_AliveCnt_o_ECU_Status_Tx, ComIPduSignalRef=Temperature_o_ECU_Status_Tx, ComIPduSignalRef=SupplyVoltage_o_ECU_Status_Tx, ComIPduSignalRef=FaultFlags_o_ECU_Status_Tx, ComPduIdRef=ECU_Status, IPduMainFunctionRef=Com_MainFunction_Tx
          ComTxIPdu: ComTxIPduUnusedAreasDefault=0, ComTxIPduClearUpdateBit=Confirmation
            ComTxModeTrue
              ComTxMode: ComTxModeMode=PERIODIC, ComTxModeTimePeriod=0.1
            ComTxModeFalse
              ComTxMode: ComTxModeMode=NONE
        Fault_Event: ComIPduDirection=SEND, ComIPduHandleId=2, ComIPduSignalRef=FaultCode_o_Fault_Event_Tx, ComIPduSignalRef=FaultActive_o_Fault_Event_Tx, ComPduIdRef=Fault_Event, IPduMainFunctionRef=Com_MainFunction_Tx
          ComTxIPdu: ComTxIPduUnusedAreasDefault=0, ComTxIPduClearUpdateBit=Confirmation
            ComTxModeTrue
              ComTxMode: ComTxModeMode=DIRECT
            ComTxModeFalse
              ComTxMode: ComTxModeMode=NONE
      ComIPduGroup_0 (ComIPduGroup): ComIPduGroupHandleId=0
      ComIPduGroup_1 (ComIPduGroup): ComIPduGroupHandleId=1
      12 x ComSignal, all with ComSignalEndianness=LITTLE_ENDIAN, ComSignalInitValue=0:
        LedCmd_o_Cmd_Control_Rx: ComBitPosition=0, ComBitSize=1, ComTimeout=0.5, ComSignalType=BOOLEAN, ComRxDataTimeoutAction=NONE, ComTransferProperty=TRIGGERED, ComSystemTemplateSystemSignalRef=LedCmd
        TargetMode_o_Cmd_Control_Rx: ComBitPosition=1, ComBitSize=3, ComTimeout=0.5, ComSignalType=UINT8, ComRxDataTimeoutAction=NONE, ComTransferProperty=TRIGGERED, ComSystemTemplateSystemSignalRef=TargetMode
        Cmd_AliveCnt_o_Cmd_Control_Rx: ComBitPosition=4, ComBitSize=4, ComTimeout=0.5, ComSignalType=UINT8, ComRxDataTimeoutAction=NONE, ComTransferProperty=TRIGGERED, ComSystemTemplateSystemSignalRef=Cmd_AliveCnt
        PwmDuty_o_Cmd_Control_Rx: ComBitPosition=8, ComBitSize=8, ComTimeout=0.5, ComSignalType=UINT8, ComRxDataTimeoutAction=NONE, ComTransferProperty=TRIGGERED, ComSystemTemplateSystemSignalRef=PwmDuty
        Cmd_Crc8_o_Cmd_Control_Rx: ComBitPosition=56, ComBitSize=8, ComTimeout=0.5, ComSignalType=UINT8, ComRxDataTimeoutAction=NONE, ComTransferProperty=TRIGGERED, ComSystemTemplateSystemSignalRef=Cmd_Crc8
        ECU_State_o_ECU_Status_Tx: ComBitPosition=0, ComBitSize=4, ComSignalType=UINT8, ComTransferProperty=PENDING, ComSystemTemplateSystemSignalRef=ECU_State
        ECU_AliveCnt_o_ECU_Status_Tx: ComBitPosition=4, ComBitSize=4, ComSignalType=UINT8, ComTransferProperty=PENDING, ComSystemTemplateSystemSignalRef=ECU_AliveCnt
        Temperature_o_ECU_Status_Tx: ComBitPosition=8, ComBitSize=8, ComSignalType=UINT8, ComTransferProperty=PENDING, ComSystemTemplateSystemSignalRef=Temperature
        SupplyVoltage_o_ECU_Status_Tx: ComBitPosition=16, ComBitSize=16, ComSignalType=UINT16, ComTransferProperty=PENDING, ComSystemTemplateSystemSignalRef=SupplyVoltage
        FaultFlags_o_ECU_Status_Tx: ComBitPosition=32, ComBitSize=8, ComSignalType=UINT8, ComTransferProperty=PENDING, ComSystemTemplateSystemSignalRef=FaultFlags
        FaultCode_o_Fault_Event_Tx: ComBitPosition=0, ComBitSize=8, ComSignalType=UINT8, ComTransferProperty=TRIGGERED, ComSystemTemplateSystemSignalRef=FaultCode
        FaultActive_o_Fault_Event_Tx: ComBitPosition=8, ComBitSize=1, ComSignalType=BOOLEAN, ComTransferProperty=TRIGGERED, ComSystemTemplateSystemSignalRef=FaultActive
    ComGeneral:
      ComCancellationSupport = true
      ComConfigurationUseDet = false
      ComEnableMDTForCyclicTransmission = true
      ComEnableSignalGroupArrayApi = false
      ComMetaDataSupport = false
      ComRetryFailedTransmitRequests = false
      ComVersionInfoApi = false
      ComSupportedIPduGroups = 2
      ComUserCbkHeaderFile = (unset)
