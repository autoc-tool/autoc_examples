AUTOSAR XML (schema 00046)
package /ActiveEcuC
  module config CanIf: implementation-config-variant=VARIANT-PRE-COMPILE, module-description=CanIf_Impl
    CanIfDispatchCfg:
      CanIfDispatchUserCtrlBusOffName = cansm_controller_bus_off
      CanIfDispatchUserCtrlBusOffUL = CAN_SM
      CanIfDispatchUserCtrlModeIndicationName = cansm_controller_mode_indication
      CanIfDispatchUserCtrlModeIndicationUL = CAN_SM
      CanIfDispatchUserTrcvModeIndicationName = cansm_transceiver_mode_indication
      CanIfDispatchUserTrcvModeIndicationUL = CAN_SM
      CanIfDispatchUserValidateWakeupEventUL = (unset)
      CanIfDispatchUserValidateWakeupEventName = (unset)
    CanIfInitCfg: CanIfMaxBufferSize=(unset), CanIfMaxRxPduCfg=(unset), CanIfMaxTxPduCfg=(unset), CanIfInitCfgSet=(unset)
      CanIfInitHohCfg
        CanHardwareObject_0 (CanIfHthCfg): CanIfHthCanCtrlIdRef=CanController_0, CanIfHthIdSymRef=CanHardwareObject_0
        CanHardwareObject_1 (CanIfHrhCfg): CanIfHrhSoftwareFilter=false, CanIfHrhCanCtrlIdRef=CanController_0, CanIfHrhIdSymRef=CanHardwareObject_1
      CanIfMaxBufferSize
      CanIfMaxRxPduCfg
      CanIfMaxTxPduCfg
      CanIfInitCfgSet
      Cmd_Control_Rx (CanIfRxPduCfg):
        CanIfRxPduCanId = 512
        CanIfRxPduDataLength = 8
        CanIfRxPduDataLengthCheck = false
        CanIfRxPduId = 0
        CanIfRxPduCanIdType = STANDARD_CAN
        CanIfRxPduUserRxIndicationUL = PDUR
        CanIfRxPduHrhIdRef = CanHardwareObject_1
        CanIfRxPduRef = Cmd_Control
      ECU_Status_Tx (CanIfTxPduCfg):
        CanIfTxPduCanId = 256
        CanIfTxPduDataLength = 8
        CanIfTxPduId = 0
        CanIfTxPduCanIdType = STANDARD_CAN
        CanIfTxPduType = STATIC
        CanIfTxPduUserTxConfirmationUL = PDUR
        CanIfTxPduBufferRef = CanIfInitCfg/CanHardwareObject_0
        CanIfTxPduRef = ECU_Status
      Fault_Event_Tx (CanIfTxPduCfg):
        CanIfTxPduCanId = 768
        CanIfTxPduDataLength = 2
        CanIfTxPduId = 1
        CanIfTxPduCanIdType = STANDARD_CAN
        CanIfTxPduType = STATIC
        CanIfTxPduUserTxConfirmationUL = PDUR
        CanIfTxPduBufferRef = CanIfInitCfg/CanHardwareObject_0
        CanIfTxPduRef = Fault_Event
      CanHardwareObject_0 (CanIfBufferCfg): CanIfBufferSize=0, CanIfBufferHthRef=CanIfInitHohCfg/CanHardwareObject_0
    CanIfPrivateCfg: CanIfSupportTTCAN=false, CanIfFixedBuffer=false, CanIfPrivateDataLengthCheck=true, CanIfPrivateSoftwareFilterType=LINEAR
    CanIfPublicCfg:
      CanIfPublicPnSupport = false
      CanIfDevErrorDetect = false
      CanIfPublicMultipleDrvSupport = false
      CanIfPublicReadRxPduDataApi = false
      CanIfPublicReadRxPduNotifyStatusApi = false
      CanIfPublicReadTxPduNotifyStatusApi = false
      CanIfPublicSetDynamicTxIdApi = false
      CanIfPublicTxBuffering = false
      CanIfPublicTxConfirmPollingSupport = true
      CanIfPublicWakeupCheckValidSupport = false
      CanIfBusMirroringSupport = false
      CanIfSetBaudrateApi = false
      CanIfMetaDataSupport = false
      CanIfPublicIcomSupport = false
      CanIfPublicWakeupCheckValidByNM = false
      CanIfTriggerTransmitSupport = true
      CanIfTxOfflineActiveSupport = false
      CanIfVersionInfoApi = false
      CanIfWakeupSupport = false
      CanIfUserTxCalloutSupport = false
      CanIfUserTxConfirmationCalloutSupport = false
      CanIfUserRxIndicationCalloutSupport = false
      CanIfPublicDebugSupport = false
      CanIfMapMcalApiPrefix = Can
      CanIfPublicHandleTypeEnum = UINT8
      CanIfPublicCddHeaderFile = 
      CanIfPublicUserCbkHeaderFile = (unset)
      CanIfPublicTxBufferMaxDepthFetchSupport = false
    CanIfCtrlDrvCfg: CanIfCtrlDrvInitHohConfigRef=(unset), CanIfCtrlDrvNameRef=(unset)
      CanIfCtrlDrvInitHohConfigRef
      CanIfCtrlDrvNameRef
      CanController_0 (CanIfCtrlCfg): CanIfCtrlId=0, CanIfCtrlWakeupSupport=false, CanIfCtrlCanCtrlRef=CanController_0
