AUTOSAR XML (schema 00046)
package /ActiveEcuC
  module config Det: implementation-config-variant=VARIANT-PRE-COMPILE
    DetConfigSet
      DetModule: DetModuleId=4096
        DetModuleInstance: DetInstanceId=0
    DetNotification: DetReportRuntimeErrorCallout=<empty>, DetReportTransientFaultCallout=<empty>, DetErrorHook=<empty>
    DetGeneral: DetForwardToDlt=false, DetVersionInfoApi=false, DetTokenNum=20, FlowControlEnable=false
