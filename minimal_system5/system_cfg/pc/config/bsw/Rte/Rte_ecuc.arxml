AUTOSAR XML (schema 00046)
package /ActiveEcuC
  module config Rte: implementation-config-variant=VARIANT-PRE-COMPILE, module-description=Rte_Impl
    RteGeneration:
      RteDevErrorDetect = false
      RteVfbTraceEnabled = false
      RteVfbTraceFunction = (unset)
      DataMappingGenerationOptimization1To1Rport = false
      DataMappingGenerationOptimizationNTo1Rport = false
      DataMappingGenerationOptimizationPport = false
      RteEaOptimization = false
      RteIsrSimplification = false
      RteSystemSignalCompuMethodEnabled = false
    RteBswGeneral
    6 x RteBswModuleInstance:
      Com: RteBswModuleConfigurationRef=Com
        3 x RteBswEventToTaskMapping, all with RteBswActivationOffset=0.0, RteBswMappedToTaskRef=OsTask_10ms, RteBswUsedOsEventRef=Rte_Ev_Cyclic2_OsTask_10ms_0_10ms:
          Com_MainFunction_RxTimingEvent0: RteBswPositionInTask=0, RteBswEventRef=Com_MainFunction_RxTimingEvent0
          Com_MainFunction_TxTimingEvent0: RteBswPositionInTask=1, RteBswEventRef=Com_MainFunction_TxTimingEvent0
          Com_MainFunction_GwTimingEvent0: RteBswPositionInTask=2, RteBswEventRef=Com_MainFunction_GwTimingEvent0
      CanSM: RteBswModuleConfigurationRef=CanSM
        CanSM_MainFunctionTimingEvent0 (RteBswEventToTaskMapping):
          RteBswActivationOffset = 0.0
          RteBswPositionInTask = 3
          RteBswEventRef = CanSM_MainFunctionTimingEvent0
          RteBswMappedToTaskRef = OsTask_10ms
          RteBswUsedOsEventRef = Rte_Ev_Cyclic2_OsTask_10ms_0_10ms
      ComM: RteBswModuleConfigurationRef=ComM
        ComM_MainFunction_ComMChannel_0TimingEvent0 (RteBswEventToTaskMapping):
          RteBswActivationOffset = 0.0
          RteBswPositionInTask = 4
          RteBswEventRef = (unset)
          RteBswMappedToTaskRef = OsTask_10ms
          RteBswUsedOsEventRef = Rte_Ev_Cyclic2_OsTask_10ms_0_10ms
      BswM: RteBswModuleConfigurationRef=BswM
        BswM_MainFunctionTimingEvent0 (RteBswEventToTaskMapping):
          RteBswActivationOffset = 0.0
          RteBswPositionInTask = 5
          RteBswEventRef = BswM_MainFunctionTimingEvent0
          RteBswMappedToTaskRef = OsTask_10ms
          RteBswUsedOsEventRef = Rte_Ev_Cyclic2_OsTask_10ms_0_10ms
      EcuM: RteBswModuleConfigurationRef=EcuM
        EcuM_MainFunctionTimingEvent0 (RteBswEventToTaskMapping):
          RteBswActivationOffset = 0.0
          RteBswPositionInTask = 6
          RteBswEventRef = EcuM_MainFunctionTimingEvent0
          RteBswMappedToTaskRef = OsTask_10ms
          RteBswUsedOsEventRef = Rte_Ev_Cyclic2_OsTask_10ms_0_10ms
      PduR: RteBswModuleConfigurationRef=PduR
        PduR_MainFunctionTimingEvent0 (RteBswEventToTaskMapping):
          RteBswActivationOffset = 0.0
          RteBswPositionInTask = 7
          RteBswEventRef = PduR_MainFunctionTimingEvent0
          RteBswMappedToTaskRef = OsTask_10ms
          RteBswUsedOsEventRef = Rte_Ev_Cyclic2_OsTask_10ms_0_10ms
    MinimalSystemApp_EcuSwComposition (RteSwComponentInstance)
      3 x RteEventToTaskMapping, all with RteActivationOffset=0.0:
        InitEvent: RtePositionInTask=0, RteEventRef=InitEvent, RteMappedToTaskRef=OsTask_Init, RteUsedOsEventRef=Rte_Ev_Run_MinimalSystemApp_RE_Init
        TimingEvent_10ms: RtePositionInTask=8, RteEventRef=TimingEvent_10ms, RteMappedToTaskRef=OsTask_10ms, RteUsedOsEventRef=Rte_Ev_Cyclic_OsTask_10ms_0_10ms
        TimingEvent_100ms: RtePositionInTask=0, RteEventRef=TimingEvent_100ms, RteMappedToTaskRef=OsTask_100ms, RteUsedOsEventRef=Rte_Ev_Cyclic_OsTask_100ms_0_100ms
    Rte (RteBswModuleInstance): RteBswImplementationRef=Rte_Impl, RteBswModuleConfigurationRef=Rte
      Rte_ComSendSignalProxyPeriodicTimingEvent0 (RteBswEventToTaskMapping):
        RteBswActivationOffset = 0.0
        RteBswPositionInTask = 9
        RteBswEventRef = Rte_ComSendSignalProxyPeriodicTimingEvent0
        RteBswMappedToTaskRef = OsTask_10ms
        RteBswUsedOsEventRef = Rte_Ev_Cyclic2_OsTask_10ms_0_10ms
